## boards/qemu/riscv64/qemu_riscv64_qemu_virt_riscv64_s_mode_defconfig
```kconfig
# Copyright (c) 2024 sensry.io
# SPDX-License-Identifier: Apache-2.0

CONFIG_CONSOLE=y
CONFIG_SERIAL=y
CONFIG_UART_CONSOLE=y
CONFIG_STACK_SENTINEL=y
CONFIG_XIP=n
CONFIG_RISCV_PMP=n
CONFIG_IDLE_STACK_SIZE=1024
CONFIG_QEMU_ICOUNT=n
# enable the SBI support
CONFIG_RISCV_SBI_BOOT=y
# Run zephyr in Supervisor mode
CONFIG_RISCV_S_MODE=y
CONFIG_RISCV_MACHINE_TIMER=n
CONFIG_RISCV_SUPERVISOR_TIMER=y
# options that have to be disabled by now
CONFIG_USERSPACE=n
CONFIG_THREAD_MONITOR=n
```

## boards/riscv/mpfs_icicle/Kconfig.board
```kconfig
# SPDX-License-Identifier: Apache-2.0

config BOARD_MPFS_ICICLE
	bool "Microsemi PolarFire SoC ICICLE kit"
	depends on SOC_MPFS
	select 64BIT
    select SCHED_IPI_SUPPORTED
	select CPU_HAS_FPU_DOUBLE_PRECISION
	select RISCV_PMP
	select ARCH_HAS_USERSPACE
	select ARCH_HAS_STACK_PROTECTION if PMP_STACK_GUARD
	select USERSPACE
	select PMP_STACK_GUARD
```

## drivers/timer/Kconfig.riscv_supervisor
```kconfig
# openSBI timer driver configuration options

# Copyright (c) 2024 sensry.io
# SPDX-License-Identifier: Apache-2.0

config RISCV_SUPERVISOR_TIMER
	bool "RISCV Supervisor Timer"
	default y
	help
	  This module implements a kernel device driver for the generic RISCV
	  timer driver running in Supervisor privilege level. It provides the
	  standard "system clock driver" interfaces.
```
